/* This file is generated by nds_ldsag (version (2015-08-19) ). */
ENTRY(_start)
SECTIONS
{
	PROVIDE (__executable_start = 0x000000);
	NDS_SAG_LMA_EILM = 0x000000 ;
	EILM_BEGIN = NDS_SAG_LMA_EILM;
	. = 0x00000000;
	.vector .	: AT(ALIGN(NDS_SAG_LMA_EILM, ALIGNOF(.vector)))	{ KEEP(*(.vector )) }
	.stub_section 	: AT(ALIGN(LOADADDR (.vector) + SIZEOF (.vector), ALIGNOF(.stub_section)))
		{ KEEP(*(.stub_section )) }
	".nds32_init_*spi_flash_wb.o" 	: AT(ALIGN(LOADADDR (.stub_section) + SIZEOF (.stub_section), ALIGNOF(".nds32_init_*spi_flash_wb.o")))
		{ KEEP(*spi_flash_wb.o(.nds32_init )) }
	".interp_*spi_flash_wb.o" 	: AT(ALIGN(LOADADDR (".nds32_init_*spi_flash_wb.o") + SIZEOF (".nds32_init_*spi_flash_wb.o"), ALIGNOF(".interp_*spi_flash_wb.o")))
		{ KEEP(*spi_flash_wb.o(.interp )) }
	".hash_*spi_flash_wb.o" 	: AT(ALIGN(LOADADDR (".interp_*spi_flash_wb.o") + SIZEOF (".interp_*spi_flash_wb.o"), ALIGNOF(".hash_*spi_flash_wb.o")))
		{ KEEP(*spi_flash_wb.o(.hash )) }
	".dynsym_*spi_flash_wb.o" 	: AT(ALIGN(LOADADDR (".hash_*spi_flash_wb.o") + SIZEOF (".hash_*spi_flash_wb.o"), ALIGNOF(".dynsym_*spi_flash_wb.o")))
		{ KEEP(*spi_flash_wb.o(.dynsym )) }
	".dynstr_*spi_flash_wb.o" 	: AT(ALIGN(LOADADDR (".dynsym_*spi_flash_wb.o") + SIZEOF (".dynsym_*spi_flash_wb.o"), ALIGNOF(".dynstr_*spi_flash_wb.o")))
		{ KEEP(*spi_flash_wb.o(.dynstr )) }
	".gnu.version_*spi_flash_wb.o" 	: AT(ALIGN(LOADADDR (".dynstr_*spi_flash_wb.o") + SIZEOF (".dynstr_*spi_flash_wb.o"), ALIGNOF(".gnu.version_*spi_flash_wb.o")))
		{ KEEP(*spi_flash_wb.o(.gnu.version )) }
	".gnu.version_d_*spi_flash_wb.o" 	: AT(ALIGN(LOADADDR (".gnu.version_*spi_flash_wb.o") + SIZEOF (".gnu.version_*spi_flash_wb.o"), ALIGNOF(".gnu.version_d_*spi_flash_wb.o")))
		{ KEEP(*spi_flash_wb.o(.gnu.version_d )) }
	".gnu.version_r_*spi_flash_wb.o" 	: AT(ALIGN(LOADADDR (".gnu.version_d_*spi_flash_wb.o") + SIZEOF (".gnu.version_d_*spi_flash_wb.o"), ALIGNOF(".gnu.version_r_*spi_flash_wb.o")))
		{ KEEP(*spi_flash_wb.o(.gnu.version_r )) }
	".rel.init_*spi_flash_wb.o" 	: AT(ALIGN(LOADADDR (".gnu.version_r_*spi_flash_wb.o") + SIZEOF (".gnu.version_r_*spi_flash_wb.o"), ALIGNOF(".rel.init_*spi_flash_wb.o")))
		{ KEEP(*spi_flash_wb.o(.rel.init )) }
	".rela.init_*spi_flash_wb.o" 	: AT(ALIGN(LOADADDR (".rel.init_*spi_flash_wb.o") + SIZEOF (".rel.init_*spi_flash_wb.o"), ALIGNOF(".rela.init_*spi_flash_wb.o")))
		{ KEEP(*spi_flash_wb.o(.rela.init )) }
	".rel.text_*spi_flash_wb.o" 	: AT(ALIGN(LOADADDR (".rela.init_*spi_flash_wb.o") + SIZEOF (".rela.init_*spi_flash_wb.o"), ALIGNOF(".rel.text_*spi_flash_wb.o")))
		{ KEEP(*spi_flash_wb.o(.rel.text .rel.text.* .rel.gnu.linkonce.t.* )) }
	".rela.text_*spi_flash_wb.o" 	: AT(ALIGN(LOADADDR (".rel.text_*spi_flash_wb.o") + SIZEOF (".rel.text_*spi_flash_wb.o"), ALIGNOF(".rela.text_*spi_flash_wb.o")))
		{ KEEP(*spi_flash_wb.o(.rela.text .rela.text.* .rela.gnu.linkonce.t.* )) }
	".rel.fini_*spi_flash_wb.o" 	: AT(ALIGN(LOADADDR (".rela.text_*spi_flash_wb.o") + SIZEOF (".rela.text_*spi_flash_wb.o"), ALIGNOF(".rel.fini_*spi_flash_wb.o")))
		{ KEEP(*spi_flash_wb.o(.rel.fini )) }
	".rela.fini_*spi_flash_wb.o" 	: AT(ALIGN(LOADADDR (".rel.fini_*spi_flash_wb.o") + SIZEOF (".rel.fini_*spi_flash_wb.o"), ALIGNOF(".rela.fini_*spi_flash_wb.o")))
		{ KEEP(*spi_flash_wb.o(.rela.fini )) }
	".rel.rodata_*spi_flash_wb.o" 	: AT(ALIGN(LOADADDR (".rela.fini_*spi_flash_wb.o") + SIZEOF (".rela.fini_*spi_flash_wb.o"), ALIGNOF(".rel.rodata_*spi_flash_wb.o")))
		{ KEEP(*spi_flash_wb.o(.rel.rodata .rel.rodata.* .rel.gnu.linkonce.r.* )) }
	".rela.rodata_*spi_flash_wb.o" 	: AT(ALIGN(LOADADDR (".rel.rodata_*spi_flash_wb.o") + SIZEOF (".rel.rodata_*spi_flash_wb.o"), ALIGNOF(".rela.rodata_*spi_flash_wb.o")))
		{ KEEP(*spi_flash_wb.o(.rela.rodata .rela.rodata.* .rela.gnu.linkonce.r.* )) }
	".rel.data.rel.ro_*spi_flash_wb.o" 	: AT(ALIGN(LOADADDR (".rela.rodata_*spi_flash_wb.o") + SIZEOF (".rela.rodata_*spi_flash_wb.o"), ALIGNOF(".rel.data.rel.ro_*spi_flash_wb.o")))
		{ KEEP(*spi_flash_wb.o(.rel.data.rel.ro* )) }
	".rela.data.rel.ro_*spi_flash_wb.o" 	: AT(ALIGN(LOADADDR (".rel.data.rel.ro_*spi_flash_wb.o") + SIZEOF (".rel.data.rel.ro_*spi_flash_wb.o"), ALIGNOF(".rela.data.rel.ro_*spi_flash_wb.o")))
		{ KEEP(*spi_flash_wb.o(.rel.data.rel.ro* )) }
	".rel.data_*spi_flash_wb.o" 	: AT(ALIGN(LOADADDR (".rela.data.rel.ro_*spi_flash_wb.o") + SIZEOF (".rela.data.rel.ro_*spi_flash_wb.o"), ALIGNOF(".rel.data_*spi_flash_wb.o")))
		{ KEEP(*spi_flash_wb.o(.rel.data .rel.data.* .rel.gnu.linkonce.d.* )) }
	".rela.data_*spi_flash_wb.o" 	: AT(ALIGN(LOADADDR (".rel.data_*spi_flash_wb.o") + SIZEOF (".rel.data_*spi_flash_wb.o"), ALIGNOF(".rela.data_*spi_flash_wb.o")))
		{ KEEP(*spi_flash_wb.o(.rela.data .rela.data.* .rela.gnu.linkonce.d.* )) }
	".rel.tdata_*spi_flash_wb.o" 	: AT(ALIGN(LOADADDR (".rela.data_*spi_flash_wb.o") + SIZEOF (".rela.data_*spi_flash_wb.o"), ALIGNOF(".rel.tdata_*spi_flash_wb.o")))
		{ KEEP(*spi_flash_wb.o(.rel.tdata .rel.tdata.* .rel.gnu.linkonce.td.* )) }
	".rela.tdata_*spi_flash_wb.o" 	: AT(ALIGN(LOADADDR (".rel.tdata_*spi_flash_wb.o") + SIZEOF (".rel.tdata_*spi_flash_wb.o"), ALIGNOF(".rela.tdata_*spi_flash_wb.o")))
		{ KEEP(*spi_flash_wb.o(.rela.tdata .rela.tdata.* .rela.gnu.linkonce.td.* )) }
	".rel.tbss_*spi_flash_wb.o" 	: AT(ALIGN(LOADADDR (".rela.tdata_*spi_flash_wb.o") + SIZEOF (".rela.tdata_*spi_flash_wb.o"), ALIGNOF(".rel.tbss_*spi_flash_wb.o")))
		{ KEEP(*spi_flash_wb.o(.rel.tbss .rel.tbss.* .rel.gnu.linkonce.tb.* )) }
	".rela.tbss_*spi_flash_wb.o" 	: AT(ALIGN(LOADADDR (".rel.tbss_*spi_flash_wb.o") + SIZEOF (".rel.tbss_*spi_flash_wb.o"), ALIGNOF(".rela.tbss_*spi_flash_wb.o")))
		{ KEEP(*spi_flash_wb.o(.rela.tbss .rela.tbss.* .rela.gnu.linkonce.tb.* )) }
	".rel.ctors_*spi_flash_wb.o" 	: AT(ALIGN(LOADADDR (".rela.tbss_*spi_flash_wb.o") + SIZEOF (".rela.tbss_*spi_flash_wb.o"), ALIGNOF(".rel.ctors_*spi_flash_wb.o")))
		{ KEEP(*spi_flash_wb.o(.rel.ctors )) }
	".rela.ctors_*spi_flash_wb.o" 	: AT(ALIGN(LOADADDR (".rel.ctors_*spi_flash_wb.o") + SIZEOF (".rel.ctors_*spi_flash_wb.o"), ALIGNOF(".rela.ctors_*spi_flash_wb.o")))
		{ KEEP(*spi_flash_wb.o(.rela.ctors )) }
	".rel.dtors_*spi_flash_wb.o" 	: AT(ALIGN(LOADADDR (".rela.ctors_*spi_flash_wb.o") + SIZEOF (".rela.ctors_*spi_flash_wb.o"), ALIGNOF(".rel.dtors_*spi_flash_wb.o")))
		{ KEEP(*spi_flash_wb.o(.rel.dtors )) }
	".rela.dtors_*spi_flash_wb.o" 	: AT(ALIGN(LOADADDR (".rel.dtors_*spi_flash_wb.o") + SIZEOF (".rel.dtors_*spi_flash_wb.o"), ALIGNOF(".rela.dtors_*spi_flash_wb.o")))
		{ KEEP(*spi_flash_wb.o(.rela.dtors )) }
	".rela.dyn_*spi_flash_wb.o" 	: AT(ALIGN(LOADADDR (".rela.dtors_*spi_flash_wb.o") + SIZEOF (".rela.dtors_*spi_flash_wb.o"), ALIGNOF(".rela.dyn_*spi_flash_wb.o")))
		{ KEEP(*spi_flash_wb.o(rela.dyn )) KEEP(*spi_flash_wb.o(.rela__libc_subfreeres )) KEEP(*spi_flash_wb.o(.rela__libc_atexit )) KEEP(*spi_flash_wb.o(.rela__libc_thread_subfreeres )) KEEP(*spi_flash_wb.o(.rela.init_array )) KEEP(*spi_flash_wb.o(.rela.fini_array )) }
	".rel.got_*spi_flash_wb.o" 	: AT(ALIGN(LOADADDR (".rela.dyn_*spi_flash_wb.o") + SIZEOF (".rela.dyn_*spi_flash_wb.o"), ALIGNOF(".rel.got_*spi_flash_wb.o")))
		{ KEEP(*spi_flash_wb.o(.rel.got )) }
	".rela.got_*spi_flash_wb.o" 	: AT(ALIGN(LOADADDR (".rel.got_*spi_flash_wb.o") + SIZEOF (".rel.got_*spi_flash_wb.o"), ALIGNOF(".rela.got_*spi_flash_wb.o")))
		{ KEEP(*spi_flash_wb.o(.rela.got )) }
	".rel.sdata_*spi_flash_wb.o" 	: AT(ALIGN(LOADADDR (".rela.got_*spi_flash_wb.o") + SIZEOF (".rela.got_*spi_flash_wb.o"), ALIGNOF(".rel.sdata_*spi_flash_wb.o")))
		{ KEEP(*spi_flash_wb.o(.rel.sdata .rel.sdata.* .rel.gnu.linkonce.s.* )) }
	".rela.sdata_*spi_flash_wb.o" 	: AT(ALIGN(LOADADDR (".rel.sdata_*spi_flash_wb.o") + SIZEOF (".rel.sdata_*spi_flash_wb.o"), ALIGNOF(".rela.sdata_*spi_flash_wb.o")))
		{ KEEP(*spi_flash_wb.o(.rela.sdata .rela.sdata.* .rela.gnu.linkonce.s.* )) }
	".rel.sbss_*spi_flash_wb.o" 	: AT(ALIGN(LOADADDR (".rela.sdata_*spi_flash_wb.o") + SIZEOF (".rela.sdata_*spi_flash_wb.o"), ALIGNOF(".rel.sbss_*spi_flash_wb.o")))
		{ KEEP(*spi_flash_wb.o(.rel.sbss .rel.sbss.* .rel.gnu.linkonce.sb.* )) }
	".rela.sbss_*spi_flash_wb.o" 	: AT(ALIGN(LOADADDR (".rel.sbss_*spi_flash_wb.o") + SIZEOF (".rel.sbss_*spi_flash_wb.o"), ALIGNOF(".rela.sbss_*spi_flash_wb.o")))
		{ KEEP(*spi_flash_wb.o(.rela.sbss .rela.sbss.* .rela.gnu.linkonce.sb.* )) }
	".rel.sdata2_*spi_flash_wb.o" 	: AT(ALIGN(LOADADDR (".rela.sbss_*spi_flash_wb.o") + SIZEOF (".rela.sbss_*spi_flash_wb.o"), ALIGNOF(".rel.sdata2_*spi_flash_wb.o")))
		{ KEEP(*spi_flash_wb.o(.rel.sdata2 .rel.sdata2.* .rel.gnu.linkonce.s2.* )) }
	".rela.sdata2_*spi_flash_wb.o" 	: AT(ALIGN(LOADADDR (".rel.sdata2_*spi_flash_wb.o") + SIZEOF (".rel.sdata2_*spi_flash_wb.o"), ALIGNOF(".rela.sdata2_*spi_flash_wb.o")))
		{ KEEP(*spi_flash_wb.o(.rela.sdata2 .rela.sdata2.* .rela.gnu.linkonce.s2.* )) }
	".rel.sbss2_*spi_flash_wb.o" 	: AT(ALIGN(LOADADDR (".rela.sdata2_*spi_flash_wb.o") + SIZEOF (".rela.sdata2_*spi_flash_wb.o"), ALIGNOF(".rel.sbss2_*spi_flash_wb.o")))
		{ KEEP(*spi_flash_wb.o(.rel.sbss2 .rel.sbss2.* .rel.gnu.linkonce.sb2.* )) }
	".rela.sbss2_*spi_flash_wb.o" 	: AT(ALIGN(LOADADDR (".rel.sbss2_*spi_flash_wb.o") + SIZEOF (".rel.sbss2_*spi_flash_wb.o"), ALIGNOF(".rela.sbss2_*spi_flash_wb.o")))
		{ KEEP(*spi_flash_wb.o(.rela.sbss2 .rela.sbss2.* .rela.gnu.linkonce.sb2.* )) }
	".rel.bss_*spi_flash_wb.o" 	: AT(ALIGN(LOADADDR (".rela.sbss2_*spi_flash_wb.o") + SIZEOF (".rela.sbss2_*spi_flash_wb.o"), ALIGNOF(".rel.bss_*spi_flash_wb.o")))
		{ KEEP(*spi_flash_wb.o(.rel.bss .rel.bss.* .rel.gnu.linkonce.b.* )) }
	".rela.bss_*spi_flash_wb.o" 	: AT(ALIGN(LOADADDR (".rel.bss_*spi_flash_wb.o") + SIZEOF (".rel.bss_*spi_flash_wb.o"), ALIGNOF(".rela.bss_*spi_flash_wb.o")))
		{ KEEP(*spi_flash_wb.o(.rela.bss .rela.bss.* .rela.gnu.linkonce.b.* )) }
	".rel.plt_*spi_flash_wb.o" 	: AT(ALIGN(LOADADDR (".rela.bss_*spi_flash_wb.o") + SIZEOF (".rela.bss_*spi_flash_wb.o"), ALIGNOF(".rel.plt_*spi_flash_wb.o")))
		{ KEEP(*spi_flash_wb.o(.rel.plt )) }
	".rela.plt_*spi_flash_wb.o" 	: AT(ALIGN(LOADADDR (".rel.plt_*spi_flash_wb.o") + SIZEOF (".rel.plt_*spi_flash_wb.o"), ALIGNOF(".rela.plt_*spi_flash_wb.o")))
		{ KEEP(*spi_flash_wb.o(.rela.plt )) }
	".init_*spi_flash_wb.o" 	: AT(ALIGN(LOADADDR (".rela.plt_*spi_flash_wb.o") + SIZEOF (".rela.plt_*spi_flash_wb.o"), ALIGNOF(".init_*spi_flash_wb.o")))
		{ KEEP(*spi_flash_wb.o(.init )) }
	".plt_*spi_flash_wb.o" 	: AT(ALIGN(LOADADDR (".init_*spi_flash_wb.o") + SIZEOF (".init_*spi_flash_wb.o"), ALIGNOF(".plt_*spi_flash_wb.o")))
		{ KEEP(*spi_flash_wb.o(.plt )) }
	".text_*spi_flash_wb.o" 	: AT(ALIGN(LOADADDR (".plt_*spi_flash_wb.o") + SIZEOF (".plt_*spi_flash_wb.o"), ALIGNOF(".text_*spi_flash_wb.o")))
		{ KEEP(*spi_flash_wb.o(.text .stub .text.* .gnu.linkonce.t.* )) KEEP(*spi_flash_wb.o(.text.*personality* )) KEEP(*spi_flash_wb.o(.gnu.warning )) . = ALIGN(4); }
	".fini_*spi_flash_wb.o" 	: AT(ALIGN(LOADADDR (".text_*spi_flash_wb.o") + SIZEOF (".text_*spi_flash_wb.o"), ALIGNOF(".fini_*spi_flash_wb.o")))
		{ KEEP(*spi_flash_wb.o(.fini )) }
	".ex9.itable_*spi_flash_wb.o" 	: AT(ALIGN(LOADADDR (".fini_*spi_flash_wb.o") + SIZEOF (".fini_*spi_flash_wb.o"), ALIGNOF(".ex9.itable_*spi_flash_wb.o")))
		{ KEEP(*spi_flash_wb.o(.ex9.itable )) }
	PROVIDE (__etext = .);
	PROVIDE (_etext = .);
	PROVIDE (etext = .);
	".rodata_*spi_flash_wb.o" 	: AT(ALIGN(LOADADDR (".ex9.itable_*spi_flash_wb.o") + SIZEOF (".ex9.itable_*spi_flash_wb.o"), ALIGNOF(".rodata_*spi_flash_wb.o")))
		{ KEEP(*spi_flash_wb.o(.rodata .rodata.* .gnu.linkonce.r.* )) }
	".rodata1_*spi_flash_wb.o" 	: AT(ALIGN(LOADADDR (".rodata_*spi_flash_wb.o") + SIZEOF (".rodata_*spi_flash_wb.o"), ALIGNOF(".rodata1_*spi_flash_wb.o")))
		{ KEEP(*spi_flash_wb.o(.rodata1 )) }
	".sdata2_*spi_flash_wb.o" 	: AT(ALIGN(LOADADDR (".rodata1_*spi_flash_wb.o") + SIZEOF (".rodata1_*spi_flash_wb.o"), ALIGNOF(".sdata2_*spi_flash_wb.o")))
		{ KEEP(*spi_flash_wb.o(.sdata2 .sdata2.* .gnu.linkonce.s2.* )) }
	".sbss2_*spi_flash_wb.o" 	: AT(ALIGN(LOADADDR (".sdata2_*spi_flash_wb.o") + SIZEOF (".sdata2_*spi_flash_wb.o"), ALIGNOF(".sbss2_*spi_flash_wb.o")))
		{ KEEP(*spi_flash_wb.o(.sbss2 .sbss2.* .gnu.linkonce.sb2.* )) }
	".eh_frame_hdr_*spi_flash_wb.o" 	: AT(ALIGN(LOADADDR (".sbss2_*spi_flash_wb.o") + SIZEOF (".sbss2_*spi_flash_wb.o"), ALIGNOF(".eh_frame_hdr_*spi_flash_wb.o")))
		{ KEEP(*spi_flash_wb.o(.eh_frame_hdr )) }
	.tcm_section 	: AT(ALIGN(LOADADDR (".eh_frame_hdr_*spi_flash_wb.o") + SIZEOF (".eh_frame_hdr_*spi_flash_wb.o"), ALIGNOF(.tcm_section)))
		{ KEEP(*(.tcm_section )) }
	".nds32_init_*sdio.o" 	: AT(ALIGN(LOADADDR (.tcm_section) + SIZEOF (.tcm_section), ALIGNOF(".nds32_init_*sdio.o")))
		{ KEEP(*sdio.o(.nds32_init )) }
	".interp_*sdio.o" 	: AT(ALIGN(LOADADDR (".nds32_init_*sdio.o") + SIZEOF (".nds32_init_*sdio.o"), ALIGNOF(".interp_*sdio.o")))
		{ KEEP(*sdio.o(.interp )) }
	".hash_*sdio.o" 	: AT(ALIGN(LOADADDR (".interp_*sdio.o") + SIZEOF (".interp_*sdio.o"), ALIGNOF(".hash_*sdio.o")))
		{ KEEP(*sdio.o(.hash )) }
	".dynsym_*sdio.o" 	: AT(ALIGN(LOADADDR (".hash_*sdio.o") + SIZEOF (".hash_*sdio.o"), ALIGNOF(".dynsym_*sdio.o")))
		{ KEEP(*sdio.o(.dynsym )) }
	".dynstr_*sdio.o" 	: AT(ALIGN(LOADADDR (".dynsym_*sdio.o") + SIZEOF (".dynsym_*sdio.o"), ALIGNOF(".dynstr_*sdio.o")))
		{ KEEP(*sdio.o(.dynstr )) }
	".gnu.version_*sdio.o" 	: AT(ALIGN(LOADADDR (".dynstr_*sdio.o") + SIZEOF (".dynstr_*sdio.o"), ALIGNOF(".gnu.version_*sdio.o")))
		{ KEEP(*sdio.o(.gnu.version )) }
	".gnu.version_d_*sdio.o" 	: AT(ALIGN(LOADADDR (".gnu.version_*sdio.o") + SIZEOF (".gnu.version_*sdio.o"), ALIGNOF(".gnu.version_d_*sdio.o")))
		{ KEEP(*sdio.o(.gnu.version_d )) }
	".gnu.version_r_*sdio.o" 	: AT(ALIGN(LOADADDR (".gnu.version_d_*sdio.o") + SIZEOF (".gnu.version_d_*sdio.o"), ALIGNOF(".gnu.version_r_*sdio.o")))
		{ KEEP(*sdio.o(.gnu.version_r )) }
	".rel.init_*sdio.o" 	: AT(ALIGN(LOADADDR (".gnu.version_r_*sdio.o") + SIZEOF (".gnu.version_r_*sdio.o"), ALIGNOF(".rel.init_*sdio.o")))
		{ KEEP(*sdio.o(.rel.init )) }
	".rela.init_*sdio.o" 	: AT(ALIGN(LOADADDR (".rel.init_*sdio.o") + SIZEOF (".rel.init_*sdio.o"), ALIGNOF(".rela.init_*sdio.o")))
		{ KEEP(*sdio.o(.rela.init )) }
	".rel.text_*sdio.o" 	: AT(ALIGN(LOADADDR (".rela.init_*sdio.o") + SIZEOF (".rela.init_*sdio.o"), ALIGNOF(".rel.text_*sdio.o")))
		{ KEEP(*sdio.o(.rel.text .rel.text.* .rel.gnu.linkonce.t.* )) }
	".rela.text_*sdio.o" 	: AT(ALIGN(LOADADDR (".rel.text_*sdio.o") + SIZEOF (".rel.text_*sdio.o"), ALIGNOF(".rela.text_*sdio.o")))
		{ KEEP(*sdio.o(.rela.text .rela.text.* .rela.gnu.linkonce.t.* )) }
	".rel.fini_*sdio.o" 	: AT(ALIGN(LOADADDR (".rela.text_*sdio.o") + SIZEOF (".rela.text_*sdio.o"), ALIGNOF(".rel.fini_*sdio.o")))
		{ KEEP(*sdio.o(.rel.fini )) }
	".rela.fini_*sdio.o" 	: AT(ALIGN(LOADADDR (".rel.fini_*sdio.o") + SIZEOF (".rel.fini_*sdio.o"), ALIGNOF(".rela.fini_*sdio.o")))
		{ KEEP(*sdio.o(.rela.fini )) }
	".rel.rodata_*sdio.o" 	: AT(ALIGN(LOADADDR (".rela.fini_*sdio.o") + SIZEOF (".rela.fini_*sdio.o"), ALIGNOF(".rel.rodata_*sdio.o")))
		{ KEEP(*sdio.o(.rel.rodata .rel.rodata.* .rel.gnu.linkonce.r.* )) }
	".rela.rodata_*sdio.o" 	: AT(ALIGN(LOADADDR (".rel.rodata_*sdio.o") + SIZEOF (".rel.rodata_*sdio.o"), ALIGNOF(".rela.rodata_*sdio.o")))
		{ KEEP(*sdio.o(.rela.rodata .rela.rodata.* .rela.gnu.linkonce.r.* )) }
	".rel.data.rel.ro_*sdio.o" 	: AT(ALIGN(LOADADDR (".rela.rodata_*sdio.o") + SIZEOF (".rela.rodata_*sdio.o"), ALIGNOF(".rel.data.rel.ro_*sdio.o")))
		{ KEEP(*sdio.o(.rel.data.rel.ro* )) }
	".rela.data.rel.ro_*sdio.o" 	: AT(ALIGN(LOADADDR (".rel.data.rel.ro_*sdio.o") + SIZEOF (".rel.data.rel.ro_*sdio.o"), ALIGNOF(".rela.data.rel.ro_*sdio.o")))
		{ KEEP(*sdio.o(.rel.data.rel.ro* )) }
	".rel.data_*sdio.o" 	: AT(ALIGN(LOADADDR (".rela.data.rel.ro_*sdio.o") + SIZEOF (".rela.data.rel.ro_*sdio.o"), ALIGNOF(".rel.data_*sdio.o")))
		{ KEEP(*sdio.o(.rel.data .rel.data.* .rel.gnu.linkonce.d.* )) }
	".rela.data_*sdio.o" 	: AT(ALIGN(LOADADDR (".rel.data_*sdio.o") + SIZEOF (".rel.data_*sdio.o"), ALIGNOF(".rela.data_*sdio.o")))
		{ KEEP(*sdio.o(.rela.data .rela.data.* .rela.gnu.linkonce.d.* )) }
	".rel.tdata_*sdio.o" 	: AT(ALIGN(LOADADDR (".rela.data_*sdio.o") + SIZEOF (".rela.data_*sdio.o"), ALIGNOF(".rel.tdata_*sdio.o")))
		{ KEEP(*sdio.o(.rel.tdata .rel.tdata.* .rel.gnu.linkonce.td.* )) }
	".rela.tdata_*sdio.o" 	: AT(ALIGN(LOADADDR (".rel.tdata_*sdio.o") + SIZEOF (".rel.tdata_*sdio.o"), ALIGNOF(".rela.tdata_*sdio.o")))
		{ KEEP(*sdio.o(.rela.tdata .rela.tdata.* .rela.gnu.linkonce.td.* )) }
	".rel.tbss_*sdio.o" 	: AT(ALIGN(LOADADDR (".rela.tdata_*sdio.o") + SIZEOF (".rela.tdata_*sdio.o"), ALIGNOF(".rel.tbss_*sdio.o")))
		{ KEEP(*sdio.o(.rel.tbss .rel.tbss.* .rel.gnu.linkonce.tb.* )) }
	".rela.tbss_*sdio.o" 	: AT(ALIGN(LOADADDR (".rel.tbss_*sdio.o") + SIZEOF (".rel.tbss_*sdio.o"), ALIGNOF(".rela.tbss_*sdio.o")))
		{ KEEP(*sdio.o(.rela.tbss .rela.tbss.* .rela.gnu.linkonce.tb.* )) }
	".rel.ctors_*sdio.o" 	: AT(ALIGN(LOADADDR (".rela.tbss_*sdio.o") + SIZEOF (".rela.tbss_*sdio.o"), ALIGNOF(".rel.ctors_*sdio.o")))
		{ KEEP(*sdio.o(.rel.ctors )) }
	".rela.ctors_*sdio.o" 	: AT(ALIGN(LOADADDR (".rel.ctors_*sdio.o") + SIZEOF (".rel.ctors_*sdio.o"), ALIGNOF(".rela.ctors_*sdio.o")))
		{ KEEP(*sdio.o(.rela.ctors )) }
	".rel.dtors_*sdio.o" 	: AT(ALIGN(LOADADDR (".rela.ctors_*sdio.o") + SIZEOF (".rela.ctors_*sdio.o"), ALIGNOF(".rel.dtors_*sdio.o")))
		{ KEEP(*sdio.o(.rel.dtors )) }
	".rela.dtors_*sdio.o" 	: AT(ALIGN(LOADADDR (".rel.dtors_*sdio.o") + SIZEOF (".rel.dtors_*sdio.o"), ALIGNOF(".rela.dtors_*sdio.o")))
		{ KEEP(*sdio.o(.rela.dtors )) }
	".rela.dyn_*sdio.o" 	: AT(ALIGN(LOADADDR (".rela.dtors_*sdio.o") + SIZEOF (".rela.dtors_*sdio.o"), ALIGNOF(".rela.dyn_*sdio.o")))
		{ KEEP(*sdio.o(rela.dyn )) KEEP(*sdio.o(.rela__libc_subfreeres )) KEEP(*sdio.o(.rela__libc_atexit )) KEEP(*sdio.o(.rela__libc_thread_subfreeres )) KEEP(*sdio.o(.rela.init_array )) KEEP(*sdio.o(.rela.fini_array )) }
	".rel.got_*sdio.o" 	: AT(ALIGN(LOADADDR (".rela.dyn_*sdio.o") + SIZEOF (".rela.dyn_*sdio.o"), ALIGNOF(".rel.got_*sdio.o")))
		{ KEEP(*sdio.o(.rel.got )) }
	".rela.got_*sdio.o" 	: AT(ALIGN(LOADADDR (".rel.got_*sdio.o") + SIZEOF (".rel.got_*sdio.o"), ALIGNOF(".rela.got_*sdio.o")))
		{ KEEP(*sdio.o(.rela.got )) }
	".rel.sdata_*sdio.o" 	: AT(ALIGN(LOADADDR (".rela.got_*sdio.o") + SIZEOF (".rela.got_*sdio.o"), ALIGNOF(".rel.sdata_*sdio.o")))
		{ KEEP(*sdio.o(.rel.sdata .rel.sdata.* .rel.gnu.linkonce.s.* )) }
	".rela.sdata_*sdio.o" 	: AT(ALIGN(LOADADDR (".rel.sdata_*sdio.o") + SIZEOF (".rel.sdata_*sdio.o"), ALIGNOF(".rela.sdata_*sdio.o")))
		{ KEEP(*sdio.o(.rela.sdata .rela.sdata.* .rela.gnu.linkonce.s.* )) }
	".rel.sbss_*sdio.o" 	: AT(ALIGN(LOADADDR (".rela.sdata_*sdio.o") + SIZEOF (".rela.sdata_*sdio.o"), ALIGNOF(".rel.sbss_*sdio.o")))
		{ KEEP(*sdio.o(.rel.sbss .rel.sbss.* .rel.gnu.linkonce.sb.* )) }
	".rela.sbss_*sdio.o" 	: AT(ALIGN(LOADADDR (".rel.sbss_*sdio.o") + SIZEOF (".rel.sbss_*sdio.o"), ALIGNOF(".rela.sbss_*sdio.o")))
		{ KEEP(*sdio.o(.rela.sbss .rela.sbss.* .rela.gnu.linkonce.sb.* )) }
	".rel.sdata2_*sdio.o" 	: AT(ALIGN(LOADADDR (".rela.sbss_*sdio.o") + SIZEOF (".rela.sbss_*sdio.o"), ALIGNOF(".rel.sdata2_*sdio.o")))
		{ KEEP(*sdio.o(.rel.sdata2 .rel.sdata2.* .rel.gnu.linkonce.s2.* )) }
	".rela.sdata2_*sdio.o" 	: AT(ALIGN(LOADADDR (".rel.sdata2_*sdio.o") + SIZEOF (".rel.sdata2_*sdio.o"), ALIGNOF(".rela.sdata2_*sdio.o")))
		{ KEEP(*sdio.o(.rela.sdata2 .rela.sdata2.* .rela.gnu.linkonce.s2.* )) }
	".rel.sbss2_*sdio.o" 	: AT(ALIGN(LOADADDR (".rela.sdata2_*sdio.o") + SIZEOF (".rela.sdata2_*sdio.o"), ALIGNOF(".rel.sbss2_*sdio.o")))
		{ KEEP(*sdio.o(.rel.sbss2 .rel.sbss2.* .rel.gnu.linkonce.sb2.* )) }
	".rela.sbss2_*sdio.o" 	: AT(ALIGN(LOADADDR (".rel.sbss2_*sdio.o") + SIZEOF (".rel.sbss2_*sdio.o"), ALIGNOF(".rela.sbss2_*sdio.o")))
		{ KEEP(*sdio.o(.rela.sbss2 .rela.sbss2.* .rela.gnu.linkonce.sb2.* )) }
	".rel.bss_*sdio.o" 	: AT(ALIGN(LOADADDR (".rela.sbss2_*sdio.o") + SIZEOF (".rela.sbss2_*sdio.o"), ALIGNOF(".rel.bss_*sdio.o")))
		{ KEEP(*sdio.o(.rel.bss .rel.bss.* .rel.gnu.linkonce.b.* )) }
	".rela.bss_*sdio.o" 	: AT(ALIGN(LOADADDR (".rel.bss_*sdio.o") + SIZEOF (".rel.bss_*sdio.o"), ALIGNOF(".rela.bss_*sdio.o")))
		{ KEEP(*sdio.o(.rela.bss .rela.bss.* .rela.gnu.linkonce.b.* )) }
	".rel.plt_*sdio.o" 	: AT(ALIGN(LOADADDR (".rela.bss_*sdio.o") + SIZEOF (".rela.bss_*sdio.o"), ALIGNOF(".rel.plt_*sdio.o")))
		{ KEEP(*sdio.o(.rel.plt )) }
	".rela.plt_*sdio.o" 	: AT(ALIGN(LOADADDR (".rel.plt_*sdio.o") + SIZEOF (".rel.plt_*sdio.o"), ALIGNOF(".rela.plt_*sdio.o")))
		{ KEEP(*sdio.o(.rela.plt )) }
	".init_*sdio.o" 	: AT(ALIGN(LOADADDR (".rela.plt_*sdio.o") + SIZEOF (".rela.plt_*sdio.o"), ALIGNOF(".init_*sdio.o")))
		{ KEEP(*sdio.o(.init )) }
	".plt_*sdio.o" 	: AT(ALIGN(LOADADDR (".init_*sdio.o") + SIZEOF (".init_*sdio.o"), ALIGNOF(".plt_*sdio.o")))
		{ KEEP(*sdio.o(.plt )) }
	".text_*sdio.o" 	: AT(ALIGN(LOADADDR (".plt_*sdio.o") + SIZEOF (".plt_*sdio.o"), ALIGNOF(".text_*sdio.o")))
		{ KEEP(*sdio.o(.text .stub .text.* .gnu.linkonce.t.* )) KEEP(*sdio.o(.text.*personality* )) KEEP(*sdio.o(.gnu.warning )) . = ALIGN(4); }
	".fini_*sdio.o" 	: AT(ALIGN(LOADADDR (".text_*sdio.o") + SIZEOF (".text_*sdio.o"), ALIGNOF(".fini_*sdio.o")))
		{ KEEP(*sdio.o(.fini )) }
	".ex9.itable_*sdio.o" 	: AT(ALIGN(LOADADDR (".fini_*sdio.o") + SIZEOF (".fini_*sdio.o"), ALIGNOF(".ex9.itable_*sdio.o")))
		{ KEEP(*sdio.o(.ex9.itable )) }
	PROVIDE (__etext = .);
	PROVIDE (_etext = .);
	PROVIDE (etext = .);
	".rodata_*sdio.o" 	: AT(ALIGN(LOADADDR (".ex9.itable_*sdio.o") + SIZEOF (".ex9.itable_*sdio.o"), ALIGNOF(".rodata_*sdio.o")))
		{ KEEP(*sdio.o(.rodata .rodata.* .gnu.linkonce.r.* )) }
	".rodata1_*sdio.o" 	: AT(ALIGN(LOADADDR (".rodata_*sdio.o") + SIZEOF (".rodata_*sdio.o"), ALIGNOF(".rodata1_*sdio.o")))
		{ KEEP(*sdio.o(.rodata1 )) }
	".sdata2_*sdio.o" 	: AT(ALIGN(LOADADDR (".rodata1_*sdio.o") + SIZEOF (".rodata1_*sdio.o"), ALIGNOF(".sdata2_*sdio.o")))
		{ KEEP(*sdio.o(.sdata2 .sdata2.* .gnu.linkonce.s2.* )) }
	".sbss2_*sdio.o" 	: AT(ALIGN(LOADADDR (".sdata2_*sdio.o") + SIZEOF (".sdata2_*sdio.o"), ALIGNOF(".sbss2_*sdio.o")))
		{ KEEP(*sdio.o(.sbss2 .sbss2.* .gnu.linkonce.sb2.* )) }
	".eh_frame_hdr_*sdio.o" 	: AT(ALIGN(LOADADDR (".sbss2_*sdio.o") + SIZEOF (".sbss2_*sdio.o"), ALIGNOF(".eh_frame_hdr_*sdio.o")))
		{ KEEP(*sdio.o(.eh_frame_hdr )) }
	".nds32_init_*sdio_wifi.o" 	: AT(ALIGN(LOADADDR (".eh_frame_hdr_*sdio.o") + SIZEOF (".eh_frame_hdr_*sdio.o"), ALIGNOF(".nds32_init_*sdio_wifi.o")))
		{ KEEP(*sdio_wifi.o(.nds32_init )) }
	".interp_*sdio_wifi.o" 	: AT(ALIGN(LOADADDR (".nds32_init_*sdio_wifi.o") + SIZEOF (".nds32_init_*sdio_wifi.o"), ALIGNOF(".interp_*sdio_wifi.o")))
		{ KEEP(*sdio_wifi.o(.interp )) }
	".hash_*sdio_wifi.o" 	: AT(ALIGN(LOADADDR (".interp_*sdio_wifi.o") + SIZEOF (".interp_*sdio_wifi.o"), ALIGNOF(".hash_*sdio_wifi.o")))
		{ KEEP(*sdio_wifi.o(.hash )) }
	".dynsym_*sdio_wifi.o" 	: AT(ALIGN(LOADADDR (".hash_*sdio_wifi.o") + SIZEOF (".hash_*sdio_wifi.o"), ALIGNOF(".dynsym_*sdio_wifi.o")))
		{ KEEP(*sdio_wifi.o(.dynsym )) }
	".dynstr_*sdio_wifi.o" 	: AT(ALIGN(LOADADDR (".dynsym_*sdio_wifi.o") + SIZEOF (".dynsym_*sdio_wifi.o"), ALIGNOF(".dynstr_*sdio_wifi.o")))
		{ KEEP(*sdio_wifi.o(.dynstr )) }
	".gnu.version_*sdio_wifi.o" 	: AT(ALIGN(LOADADDR (".dynstr_*sdio_wifi.o") + SIZEOF (".dynstr_*sdio_wifi.o"), ALIGNOF(".gnu.version_*sdio_wifi.o")))
		{ KEEP(*sdio_wifi.o(.gnu.version )) }
	".gnu.version_d_*sdio_wifi.o" 	: AT(ALIGN(LOADADDR (".gnu.version_*sdio_wifi.o") + SIZEOF (".gnu.version_*sdio_wifi.o"), ALIGNOF(".gnu.version_d_*sdio_wifi.o")))
		{ KEEP(*sdio_wifi.o(.gnu.version_d )) }
	".gnu.version_r_*sdio_wifi.o" 	: AT(ALIGN(LOADADDR (".gnu.version_d_*sdio_wifi.o") + SIZEOF (".gnu.version_d_*sdio_wifi.o"), ALIGNOF(".gnu.version_r_*sdio_wifi.o")))
		{ KEEP(*sdio_wifi.o(.gnu.version_r )) }
	".rel.init_*sdio_wifi.o" 	: AT(ALIGN(LOADADDR (".gnu.version_r_*sdio_wifi.o") + SIZEOF (".gnu.version_r_*sdio_wifi.o"), ALIGNOF(".rel.init_*sdio_wifi.o")))
		{ KEEP(*sdio_wifi.o(.rel.init )) }
	".rela.init_*sdio_wifi.o" 	: AT(ALIGN(LOADADDR (".rel.init_*sdio_wifi.o") + SIZEOF (".rel.init_*sdio_wifi.o"), ALIGNOF(".rela.init_*sdio_wifi.o")))
		{ KEEP(*sdio_wifi.o(.rela.init )) }
	".rel.text_*sdio_wifi.o" 	: AT(ALIGN(LOADADDR (".rela.init_*sdio_wifi.o") + SIZEOF (".rela.init_*sdio_wifi.o"), ALIGNOF(".rel.text_*sdio_wifi.o")))
		{ KEEP(*sdio_wifi.o(.rel.text .rel.text.* .rel.gnu.linkonce.t.* )) }
	".rela.text_*sdio_wifi.o" 	: AT(ALIGN(LOADADDR (".rel.text_*sdio_wifi.o") + SIZEOF (".rel.text_*sdio_wifi.o"), ALIGNOF(".rela.text_*sdio_wifi.o")))
		{ KEEP(*sdio_wifi.o(.rela.text .rela.text.* .rela.gnu.linkonce.t.* )) }
	".rel.fini_*sdio_wifi.o" 	: AT(ALIGN(LOADADDR (".rela.text_*sdio_wifi.o") + SIZEOF (".rela.text_*sdio_wifi.o"), ALIGNOF(".rel.fini_*sdio_wifi.o")))
		{ KEEP(*sdio_wifi.o(.rel.fini )) }
	".rela.fini_*sdio_wifi.o" 	: AT(ALIGN(LOADADDR (".rel.fini_*sdio_wifi.o") + SIZEOF (".rel.fini_*sdio_wifi.o"), ALIGNOF(".rela.fini_*sdio_wifi.o")))
		{ KEEP(*sdio_wifi.o(.rela.fini )) }
	".rel.rodata_*sdio_wifi.o" 	: AT(ALIGN(LOADADDR (".rela.fini_*sdio_wifi.o") + SIZEOF (".rela.fini_*sdio_wifi.o"), ALIGNOF(".rel.rodata_*sdio_wifi.o")))
		{ KEEP(*sdio_wifi.o(.rel.rodata .rel.rodata.* .rel.gnu.linkonce.r.* )) }
	".rela.rodata_*sdio_wifi.o" 	: AT(ALIGN(LOADADDR (".rel.rodata_*sdio_wifi.o") + SIZEOF (".rel.rodata_*sdio_wifi.o"), ALIGNOF(".rela.rodata_*sdio_wifi.o")))
		{ KEEP(*sdio_wifi.o(.rela.rodata .rela.rodata.* .rela.gnu.linkonce.r.* )) }
	".rel.data.rel.ro_*sdio_wifi.o" 	: AT(ALIGN(LOADADDR (".rela.rodata_*sdio_wifi.o") + SIZEOF (".rela.rodata_*sdio_wifi.o"), ALIGNOF(".rel.data.rel.ro_*sdio_wifi.o")))
		{ KEEP(*sdio_wifi.o(.rel.data.rel.ro* )) }
	".rela.data.rel.ro_*sdio_wifi.o" 	: AT(ALIGN(LOADADDR (".rel.data.rel.ro_*sdio_wifi.o") + SIZEOF (".rel.data.rel.ro_*sdio_wifi.o"), ALIGNOF(".rela.data.rel.ro_*sdio_wifi.o")))
		{ KEEP(*sdio_wifi.o(.rel.data.rel.ro* )) }
	".rel.data_*sdio_wifi.o" 	: AT(ALIGN(LOADADDR (".rela.data.rel.ro_*sdio_wifi.o") + SIZEOF (".rela.data.rel.ro_*sdio_wifi.o"), ALIGNOF(".rel.data_*sdio_wifi.o")))
		{ KEEP(*sdio_wifi.o(.rel.data .rel.data.* .rel.gnu.linkonce.d.* )) }
	".rela.data_*sdio_wifi.o" 	: AT(ALIGN(LOADADDR (".rel.data_*sdio_wifi.o") + SIZEOF (".rel.data_*sdio_wifi.o"), ALIGNOF(".rela.data_*sdio_wifi.o")))
		{ KEEP(*sdio_wifi.o(.rela.data .rela.data.* .rela.gnu.linkonce.d.* )) }
	".rel.tdata_*sdio_wifi.o" 	: AT(ALIGN(LOADADDR (".rela.data_*sdio_wifi.o") + SIZEOF (".rela.data_*sdio_wifi.o"), ALIGNOF(".rel.tdata_*sdio_wifi.o")))
		{ KEEP(*sdio_wifi.o(.rel.tdata .rel.tdata.* .rel.gnu.linkonce.td.* )) }
	".rela.tdata_*sdio_wifi.o" 	: AT(ALIGN(LOADADDR (".rel.tdata_*sdio_wifi.o") + SIZEOF (".rel.tdata_*sdio_wifi.o"), ALIGNOF(".rela.tdata_*sdio_wifi.o")))
		{ KEEP(*sdio_wifi.o(.rela.tdata .rela.tdata.* .rela.gnu.linkonce.td.* )) }
	".rel.tbss_*sdio_wifi.o" 	: AT(ALIGN(LOADADDR (".rela.tdata_*sdio_wifi.o") + SIZEOF (".rela.tdata_*sdio_wifi.o"), ALIGNOF(".rel.tbss_*sdio_wifi.o")))
		{ KEEP(*sdio_wifi.o(.rel.tbss .rel.tbss.* .rel.gnu.linkonce.tb.* )) }
	".rela.tbss_*sdio_wifi.o" 	: AT(ALIGN(LOADADDR (".rel.tbss_*sdio_wifi.o") + SIZEOF (".rel.tbss_*sdio_wifi.o"), ALIGNOF(".rela.tbss_*sdio_wifi.o")))
		{ KEEP(*sdio_wifi.o(.rela.tbss .rela.tbss.* .rela.gnu.linkonce.tb.* )) }
	".rel.ctors_*sdio_wifi.o" 	: AT(ALIGN(LOADADDR (".rela.tbss_*sdio_wifi.o") + SIZEOF (".rela.tbss_*sdio_wifi.o"), ALIGNOF(".rel.ctors_*sdio_wifi.o")))
		{ KEEP(*sdio_wifi.o(.rel.ctors )) }
	".rela.ctors_*sdio_wifi.o" 	: AT(ALIGN(LOADADDR (".rel.ctors_*sdio_wifi.o") + SIZEOF (".rel.ctors_*sdio_wifi.o"), ALIGNOF(".rela.ctors_*sdio_wifi.o")))
		{ KEEP(*sdio_wifi.o(.rela.ctors )) }
	".rel.dtors_*sdio_wifi.o" 	: AT(ALIGN(LOADADDR (".rela.ctors_*sdio_wifi.o") + SIZEOF (".rela.ctors_*sdio_wifi.o"), ALIGNOF(".rel.dtors_*sdio_wifi.o")))
		{ KEEP(*sdio_wifi.o(.rel.dtors )) }
	".rela.dtors_*sdio_wifi.o" 	: AT(ALIGN(LOADADDR (".rel.dtors_*sdio_wifi.o") + SIZEOF (".rel.dtors_*sdio_wifi.o"), ALIGNOF(".rela.dtors_*sdio_wifi.o")))
		{ KEEP(*sdio_wifi.o(.rela.dtors )) }
	".rela.dyn_*sdio_wifi.o" 	: AT(ALIGN(LOADADDR (".rela.dtors_*sdio_wifi.o") + SIZEOF (".rela.dtors_*sdio_wifi.o"), ALIGNOF(".rela.dyn_*sdio_wifi.o")))
		{ KEEP(*sdio_wifi.o(rela.dyn )) KEEP(*sdio_wifi.o(.rela__libc_subfreeres )) KEEP(*sdio_wifi.o(.rela__libc_atexit )) KEEP(*sdio_wifi.o(.rela__libc_thread_subfreeres )) KEEP(*sdio_wifi.o(.rela.init_array )) KEEP(*sdio_wifi.o(.rela.fini_array )) }
	".rel.got_*sdio_wifi.o" 	: AT(ALIGN(LOADADDR (".rela.dyn_*sdio_wifi.o") + SIZEOF (".rela.dyn_*sdio_wifi.o"), ALIGNOF(".rel.got_*sdio_wifi.o")))
		{ KEEP(*sdio_wifi.o(.rel.got )) }
	".rela.got_*sdio_wifi.o" 	: AT(ALIGN(LOADADDR (".rel.got_*sdio_wifi.o") + SIZEOF (".rel.got_*sdio_wifi.o"), ALIGNOF(".rela.got_*sdio_wifi.o")))
		{ KEEP(*sdio_wifi.o(.rela.got )) }
	".rel.sdata_*sdio_wifi.o" 	: AT(ALIGN(LOADADDR (".rela.got_*sdio_wifi.o") + SIZEOF (".rela.got_*sdio_wifi.o"), ALIGNOF(".rel.sdata_*sdio_wifi.o")))
		{ KEEP(*sdio_wifi.o(.rel.sdata .rel.sdata.* .rel.gnu.linkonce.s.* )) }
	".rela.sdata_*sdio_wifi.o" 	: AT(ALIGN(LOADADDR (".rel.sdata_*sdio_wifi.o") + SIZEOF (".rel.sdata_*sdio_wifi.o"), ALIGNOF(".rela.sdata_*sdio_wifi.o")))
		{ KEEP(*sdio_wifi.o(.rela.sdata .rela.sdata.* .rela.gnu.linkonce.s.* )) }
	".rel.sbss_*sdio_wifi.o" 	: AT(ALIGN(LOADADDR (".rela.sdata_*sdio_wifi.o") + SIZEOF (".rela.sdata_*sdio_wifi.o"), ALIGNOF(".rel.sbss_*sdio_wifi.o")))
		{ KEEP(*sdio_wifi.o(.rel.sbss .rel.sbss.* .rel.gnu.linkonce.sb.* )) }
	".rela.sbss_*sdio_wifi.o" 	: AT(ALIGN(LOADADDR (".rel.sbss_*sdio_wifi.o") + SIZEOF (".rel.sbss_*sdio_wifi.o"), ALIGNOF(".rela.sbss_*sdio_wifi.o")))
		{ KEEP(*sdio_wifi.o(.rela.sbss .rela.sbss.* .rela.gnu.linkonce.sb.* )) }
	".rel.sdata2_*sdio_wifi.o" 	: AT(ALIGN(LOADADDR (".rela.sbss_*sdio_wifi.o") + SIZEOF (".rela.sbss_*sdio_wifi.o"), ALIGNOF(".rel.sdata2_*sdio_wifi.o")))
		{ KEEP(*sdio_wifi.o(.rel.sdata2 .rel.sdata2.* .rel.gnu.linkonce.s2.* )) }
	".rela.sdata2_*sdio_wifi.o" 	: AT(ALIGN(LOADADDR (".rel.sdata2_*sdio_wifi.o") + SIZEOF (".rel.sdata2_*sdio_wifi.o"), ALIGNOF(".rela.sdata2_*sdio_wifi.o")))
		{ KEEP(*sdio_wifi.o(.rela.sdata2 .rela.sdata2.* .rela.gnu.linkonce.s2.* )) }
	".rel.sbss2_*sdio_wifi.o" 	: AT(ALIGN(LOADADDR (".rela.sdata2_*sdio_wifi.o") + SIZEOF (".rela.sdata2_*sdio_wifi.o"), ALIGNOF(".rel.sbss2_*sdio_wifi.o")))
		{ KEEP(*sdio_wifi.o(.rel.sbss2 .rel.sbss2.* .rel.gnu.linkonce.sb2.* )) }
	".rela.sbss2_*sdio_wifi.o" 	: AT(ALIGN(LOADADDR (".rel.sbss2_*sdio_wifi.o") + SIZEOF (".rel.sbss2_*sdio_wifi.o"), ALIGNOF(".rela.sbss2_*sdio_wifi.o")))
		{ KEEP(*sdio_wifi.o(.rela.sbss2 .rela.sbss2.* .rela.gnu.linkonce.sb2.* )) }
	".rel.bss_*sdio_wifi.o" 	: AT(ALIGN(LOADADDR (".rela.sbss2_*sdio_wifi.o") + SIZEOF (".rela.sbss2_*sdio_wifi.o"), ALIGNOF(".rel.bss_*sdio_wifi.o")))
		{ KEEP(*sdio_wifi.o(.rel.bss .rel.bss.* .rel.gnu.linkonce.b.* )) }
	".rela.bss_*sdio_wifi.o" 	: AT(ALIGN(LOADADDR (".rel.bss_*sdio_wifi.o") + SIZEOF (".rel.bss_*sdio_wifi.o"), ALIGNOF(".rela.bss_*sdio_wifi.o")))
		{ KEEP(*sdio_wifi.o(.rela.bss .rela.bss.* .rela.gnu.linkonce.b.* )) }
	".rel.plt_*sdio_wifi.o" 	: AT(ALIGN(LOADADDR (".rela.bss_*sdio_wifi.o") + SIZEOF (".rela.bss_*sdio_wifi.o"), ALIGNOF(".rel.plt_*sdio_wifi.o")))
		{ KEEP(*sdio_wifi.o(.rel.plt )) }
	".rela.plt_*sdio_wifi.o" 	: AT(ALIGN(LOADADDR (".rel.plt_*sdio_wifi.o") + SIZEOF (".rel.plt_*sdio_wifi.o"), ALIGNOF(".rela.plt_*sdio_wifi.o")))
		{ KEEP(*sdio_wifi.o(.rela.plt )) }
	".init_*sdio_wifi.o" 	: AT(ALIGN(LOADADDR (".rela.plt_*sdio_wifi.o") + SIZEOF (".rela.plt_*sdio_wifi.o"), ALIGNOF(".init_*sdio_wifi.o")))
		{ KEEP(*sdio_wifi.o(.init )) }
	".plt_*sdio_wifi.o" 	: AT(ALIGN(LOADADDR (".init_*sdio_wifi.o") + SIZEOF (".init_*sdio_wifi.o"), ALIGNOF(".plt_*sdio_wifi.o")))
		{ KEEP(*sdio_wifi.o(.plt )) }
	".text_*sdio_wifi.o" 	: AT(ALIGN(LOADADDR (".plt_*sdio_wifi.o") + SIZEOF (".plt_*sdio_wifi.o"), ALIGNOF(".text_*sdio_wifi.o")))
		{ KEEP(*sdio_wifi.o(.text .stub .text.* .gnu.linkonce.t.* )) KEEP(*sdio_wifi.o(.text.*personality* )) KEEP(*sdio_wifi.o(.gnu.warning )) . = ALIGN(4); }
	".fini_*sdio_wifi.o" 	: AT(ALIGN(LOADADDR (".text_*sdio_wifi.o") + SIZEOF (".text_*sdio_wifi.o"), ALIGNOF(".fini_*sdio_wifi.o")))
		{ KEEP(*sdio_wifi.o(.fini )) }
	".ex9.itable_*sdio_wifi.o" 	: AT(ALIGN(LOADADDR (".fini_*sdio_wifi.o") + SIZEOF (".fini_*sdio_wifi.o"), ALIGNOF(".ex9.itable_*sdio_wifi.o")))
		{ KEEP(*sdio_wifi.o(.ex9.itable )) }
	PROVIDE (__etext = .);
	PROVIDE (_etext = .);
	PROVIDE (etext = .);
	".rodata_*sdio_wifi.o" 	: AT(ALIGN(LOADADDR (".ex9.itable_*sdio_wifi.o") + SIZEOF (".ex9.itable_*sdio_wifi.o"), ALIGNOF(".rodata_*sdio_wifi.o")))
		{ KEEP(*sdio_wifi.o(.rodata .rodata.* .gnu.linkonce.r.* )) }
	".rodata1_*sdio_wifi.o" 	: AT(ALIGN(LOADADDR (".rodata_*sdio_wifi.o") + SIZEOF (".rodata_*sdio_wifi.o"), ALIGNOF(".rodata1_*sdio_wifi.o")))
		{ KEEP(*sdio_wifi.o(.rodata1 )) }
	".sdata2_*sdio_wifi.o" 	: AT(ALIGN(LOADADDR (".rodata1_*sdio_wifi.o") + SIZEOF (".rodata1_*sdio_wifi.o"), ALIGNOF(".sdata2_*sdio_wifi.o")))
		{ KEEP(*sdio_wifi.o(.sdata2 .sdata2.* .gnu.linkonce.s2.* )) }
	".sbss2_*sdio_wifi.o" 	: AT(ALIGN(LOADADDR (".sdata2_*sdio_wifi.o") + SIZEOF (".sdata2_*sdio_wifi.o"), ALIGNOF(".sbss2_*sdio_wifi.o")))
		{ KEEP(*sdio_wifi.o(.sbss2 .sbss2.* .gnu.linkonce.sb2.* )) }
	".eh_frame_hdr_*sdio_wifi.o" 	: AT(ALIGN(LOADADDR (".sbss2_*sdio_wifi.o") + SIZEOF (".sbss2_*sdio_wifi.o"), ALIGNOF(".eh_frame_hdr_*sdio_wifi.o")))
		{ KEEP(*sdio_wifi.o(.eh_frame_hdr )) }
	.driver.isr 	: AT(ALIGN(LOADADDR (".eh_frame_hdr_*sdio_wifi.o") + SIZEOF (".eh_frame_hdr_*sdio_wifi.o"), ALIGNOF(.driver.isr)))
		{ KEEP(*(.driver.isr )) }
	.nds32_vector 	: AT(ALIGN(LOADADDR (.driver.isr) + SIZEOF (.driver.isr), ALIGNOF(.nds32_vector)))
		{ KEEP(*(.nds32_vector )) KEEP(*(SORT(.nds32_vector.* ))) }
	.nds32_nmih 	: AT(ALIGN(LOADADDR (.nds32_vector) + SIZEOF (.nds32_vector), ALIGNOF(.nds32_nmih)))
		{ *(.nds32_nmih ) }
	.nds32_wrh 	: AT(ALIGN(LOADADDR (.nds32_nmih) + SIZEOF (.nds32_nmih), ALIGNOF(.nds32_wrh)))
		{ *(.nds32_wrh ) }
	.nds32_jmptbl 	: AT(ALIGN(LOADADDR (.nds32_wrh) + SIZEOF (.nds32_wrh), ALIGNOF(.nds32_jmptbl)))
		{ KEEP(*(.nds32_jmptbl )) KEEP(*(SORT(.nds32_jmptbl.* ))) }
	.nds32_isr 	: AT(ALIGN(LOADADDR (.nds32_jmptbl) + SIZEOF (.nds32_jmptbl), ALIGNOF(.nds32_isr)))
		{ *(.nds32_isr ) }
	.nds32_init 	: AT(ALIGN(LOADADDR (.nds32_isr) + SIZEOF (.nds32_isr), ALIGNOF(.nds32_init)))
		{ KEEP(*(.nds32_init )) }
	.interp 	: AT(ALIGN(LOADADDR (.nds32_init) + SIZEOF (.nds32_init), ALIGNOF(.interp)))
		{ *(.interp ) }
	.hash 	: AT(ALIGN(LOADADDR (.interp) + SIZEOF (.interp), ALIGNOF(.hash)))
		{ *(.hash ) }
	.dynsym 	: AT(ALIGN(LOADADDR (.hash) + SIZEOF (.hash), ALIGNOF(.dynsym)))
		{ *(.dynsym ) }
	.dynstr 	: AT(ALIGN(LOADADDR (.dynsym) + SIZEOF (.dynsym), ALIGNOF(.dynstr)))
		{ *(.dynstr ) }
	.gnu.version 	: AT(ALIGN(LOADADDR (.dynstr) + SIZEOF (.dynstr), ALIGNOF(.gnu.version)))
		{ *(.gnu.version ) }
	.gnu.version_d 	: AT(ALIGN(LOADADDR (.gnu.version) + SIZEOF (.gnu.version), ALIGNOF(.gnu.version_d)))
		{ *(.gnu.version_d ) }
	.gnu.version_r 	: AT(ALIGN(LOADADDR (.gnu.version_d) + SIZEOF (.gnu.version_d), ALIGNOF(.gnu.version_r)))
		{ *(.gnu.version_r ) }
	.rel.init 	: AT(ALIGN(LOADADDR (.gnu.version_r) + SIZEOF (.gnu.version_r), ALIGNOF(.rel.init)))
		{ *(.rel.init ) }
	.rela.init 	: AT(ALIGN(LOADADDR (.rel.init) + SIZEOF (.rel.init), ALIGNOF(.rela.init)))
		{ *(.rela.init ) }
	.rel.text 	: AT(ALIGN(LOADADDR (.rela.init) + SIZEOF (.rela.init), ALIGNOF(.rel.text)))
		{ *(.rel.text .rel.text.* .rel.gnu.linkonce.t.* ) }
	.rela.text 	: AT(ALIGN(LOADADDR (.rel.text) + SIZEOF (.rel.text), ALIGNOF(.rela.text)))
		{ *(.rela.text .rela.text.* .rela.gnu.linkonce.t.* ) }
	.rel.fini 	: AT(ALIGN(LOADADDR (.rela.text) + SIZEOF (.rela.text), ALIGNOF(.rel.fini)))
		{ *(.rel.fini ) }
	.rela.fini 	: AT(ALIGN(LOADADDR (.rel.fini) + SIZEOF (.rel.fini), ALIGNOF(.rela.fini)))
		{ *(.rela.fini ) }
	.rel.rodata 	: AT(ALIGN(LOADADDR (.rela.fini) + SIZEOF (.rela.fini), ALIGNOF(.rel.rodata)))
		{ *(.rel.rodata .rel.rodata.* .rel.gnu.linkonce.r.* ) }
	.rela.rodata 	: AT(ALIGN(LOADADDR (.rel.rodata) + SIZEOF (.rel.rodata), ALIGNOF(.rela.rodata)))
		{ *(.rela.rodata .rela.rodata.* .rela.gnu.linkonce.r.* ) }
	.rel.data.rel.ro 	: AT(ALIGN(LOADADDR (.rela.rodata) + SIZEOF (.rela.rodata), ALIGNOF(.rel.data.rel.ro)))
		{ *(.rel.data.rel.ro* ) }
	.rela.data.rel.ro 	: AT(ALIGN(LOADADDR (.rel.data.rel.ro) + SIZEOF (.rel.data.rel.ro), ALIGNOF(.rela.data.rel.ro)))
		{ *(.rel.data.rel.ro* ) }
	.rel.data 	: AT(ALIGN(LOADADDR (.rela.data.rel.ro) + SIZEOF (.rela.data.rel.ro), ALIGNOF(.rel.data)))
		{ *(.rel.data .rel.data.* .rel.gnu.linkonce.d.* ) }
	.rela.data 	: AT(ALIGN(LOADADDR (.rel.data) + SIZEOF (.rel.data), ALIGNOF(.rela.data)))
		{ *(.rela.data .rela.data.* .rela.gnu.linkonce.d.* ) }
	.rel.tdata 	: AT(ALIGN(LOADADDR (.rela.data) + SIZEOF (.rela.data), ALIGNOF(.rel.tdata)))
		{ *(.rel.tdata .rel.tdata.* .rel.gnu.linkonce.td.* ) }
	.rela.tdata 	: AT(ALIGN(LOADADDR (.rel.tdata) + SIZEOF (.rel.tdata), ALIGNOF(.rela.tdata)))
		{ *(.rela.tdata .rela.tdata.* .rela.gnu.linkonce.td.* ) }
	.rel.tbss 	: AT(ALIGN(LOADADDR (.rela.tdata) + SIZEOF (.rela.tdata), ALIGNOF(.rel.tbss)))
		{ *(.rel.tbss .rel.tbss.* .rel.gnu.linkonce.tb.* ) }
	.rela.tbss 	: AT(ALIGN(LOADADDR (.rel.tbss) + SIZEOF (.rel.tbss), ALIGNOF(.rela.tbss)))
		{ *(.rela.tbss .rela.tbss.* .rela.gnu.linkonce.tb.* ) }
	.rel.ctors 	: AT(ALIGN(LOADADDR (.rela.tbss) + SIZEOF (.rela.tbss), ALIGNOF(.rel.ctors)))
		{ *(.rel.ctors ) }
	.rela.ctors 	: AT(ALIGN(LOADADDR (.rel.ctors) + SIZEOF (.rel.ctors), ALIGNOF(.rela.ctors)))
		{ *(.rela.ctors ) }
	.rel.dtors 	: AT(ALIGN(LOADADDR (.rela.ctors) + SIZEOF (.rela.ctors), ALIGNOF(.rel.dtors)))
		{ *(.rel.dtors ) }
	.rela.dtors 	: AT(ALIGN(LOADADDR (.rel.dtors) + SIZEOF (.rel.dtors), ALIGNOF(.rela.dtors)))
		{ *(.rela.dtors ) }
	.rela.dyn 	: AT(ALIGN(LOADADDR (.rela.dtors) + SIZEOF (.rela.dtors), ALIGNOF(.rela.dyn)))
		{ *(rela.dyn ) *(.rela__libc_subfreeres ) *(.rela__libc_atexit ) *(.rela__libc_thread_subfreeres ) *(.rela.init_array ) *(.rela.fini_array ) }
	.rel.got 	: AT(ALIGN(LOADADDR (.rela.dyn) + SIZEOF (.rela.dyn), ALIGNOF(.rel.got)))
		{ *(.rel.got ) }
	.rela.got 	: AT(ALIGN(LOADADDR (.rel.got) + SIZEOF (.rel.got), ALIGNOF(.rela.got)))
		{ *(.rela.got ) }
	.rel.sdata 	: AT(ALIGN(LOADADDR (.rela.got) + SIZEOF (.rela.got), ALIGNOF(.rel.sdata)))
		{ *(.rel.sdata .rel.sdata.* .rel.gnu.linkonce.s.* ) }
	.rela.sdata 	: AT(ALIGN(LOADADDR (.rel.sdata) + SIZEOF (.rel.sdata), ALIGNOF(.rela.sdata)))
		{ *(.rela.sdata .rela.sdata.* .rela.gnu.linkonce.s.* ) }
	.rel.sbss 	: AT(ALIGN(LOADADDR (.rela.sdata) + SIZEOF (.rela.sdata), ALIGNOF(.rel.sbss)))
		{ *(.rel.sbss .rel.sbss.* .rel.gnu.linkonce.sb.* ) }
	.rela.sbss 	: AT(ALIGN(LOADADDR (.rel.sbss) + SIZEOF (.rel.sbss), ALIGNOF(.rela.sbss)))
		{ *(.rela.sbss .rela.sbss.* .rela.gnu.linkonce.sb.* ) }
	.rel.sdata2 	: AT(ALIGN(LOADADDR (.rela.sbss) + SIZEOF (.rela.sbss), ALIGNOF(.rel.sdata2)))
		{ *(.rel.sdata2 .rel.sdata2.* .rel.gnu.linkonce.s2.* ) }
	.rela.sdata2 	: AT(ALIGN(LOADADDR (.rel.sdata2) + SIZEOF (.rel.sdata2), ALIGNOF(.rela.sdata2)))
		{ *(.rela.sdata2 .rela.sdata2.* .rela.gnu.linkonce.s2.* ) }
	.rel.sbss2 	: AT(ALIGN(LOADADDR (.rela.sdata2) + SIZEOF (.rela.sdata2), ALIGNOF(.rel.sbss2)))
		{ *(.rel.sbss2 .rel.sbss2.* .rel.gnu.linkonce.sb2.* ) }
	.rela.sbss2 	: AT(ALIGN(LOADADDR (.rel.sbss2) + SIZEOF (.rel.sbss2), ALIGNOF(.rela.sbss2)))
		{ *(.rela.sbss2 .rela.sbss2.* .rela.gnu.linkonce.sb2.* ) }
	.rel.bss 	: AT(ALIGN(LOADADDR (.rela.sbss2) + SIZEOF (.rela.sbss2), ALIGNOF(.rel.bss)))
		{ *(.rel.bss .rel.bss.* .rel.gnu.linkonce.b.* ) }
	.rela.bss 	: AT(ALIGN(LOADADDR (.rel.bss) + SIZEOF (.rel.bss), ALIGNOF(.rela.bss)))
		{ *(.rela.bss .rela.bss.* .rela.gnu.linkonce.b.* ) }
	.rel.plt 	: AT(ALIGN(LOADADDR (.rela.bss) + SIZEOF (.rela.bss), ALIGNOF(.rel.plt)))
		{ *(.rel.plt ) }
	.rela.plt 	: AT(ALIGN(LOADADDR (.rel.plt) + SIZEOF (.rel.plt), ALIGNOF(.rela.plt)))
		{ *(.rela.plt ) }
	.init 	: AT(ALIGN(LOADADDR (.rela.plt) + SIZEOF (.rela.plt), ALIGNOF(.init)))
		{ KEEP(*(.init )) }
	.plt 	: AT(ALIGN(LOADADDR (.init) + SIZEOF (.init), ALIGNOF(.plt)))
		{ *(.plt ) }
	.text 	: AT(ALIGN(LOADADDR (.plt) + SIZEOF (.plt), ALIGNOF(.text)))
		{ *(.text .stub .text.* .gnu.linkonce.t.* ) KEEP(*(.text.*personality* )) *(.gnu.warning ) . = ALIGN(4); }
	.fini 	: AT(ALIGN(LOADADDR (.text) + SIZEOF (.text), ALIGNOF(.fini)))
		{ KEEP(*(.fini )) }
	.ex9.itable 	: AT(ALIGN(LOADADDR (.fini) + SIZEOF (.fini), ALIGNOF(.ex9.itable)))
		{ *(.ex9.itable ) }
	PROVIDE (__etext = .);
	PROVIDE (_etext = .);
	PROVIDE (etext = .);
	.rodata 	: AT(ALIGN(LOADADDR (.ex9.itable) + SIZEOF (.ex9.itable), ALIGNOF(.rodata)))
		{ *(.rodata .rodata.* .gnu.linkonce.r.* ) }
	.rodata1 	: AT(ALIGN(LOADADDR (.rodata) + SIZEOF (.rodata), ALIGNOF(.rodata1)))
		{ *(.rodata1 ) }
	.sdata2 	: AT(ALIGN(LOADADDR (.rodata1) + SIZEOF (.rodata1), ALIGNOF(.sdata2)))
		{ *(.sdata2 .sdata2.* .gnu.linkonce.s2.* ) }
	.sbss2 	: AT(ALIGN(LOADADDR (.sdata2) + SIZEOF (.sdata2), ALIGNOF(.sbss2)))
		{ *(.sbss2 .sbss2.* .gnu.linkonce.sb2.* ) }
	.eh_frame_hdr 	: AT(ALIGN(LOADADDR (.sbss2) + SIZEOF (.sbss2), ALIGNOF(.eh_frame_hdr)))
		{ *(.eh_frame_hdr ) }
	. = . + 0;
	__ram_code_start =  LOADADDR (.ram.code);
	.ram.code 	: AT(ALIGN(LOADADDR (.eh_frame_hdr) + SIZEOF (.eh_frame_hdr), ALIGNOF(.ram.code)))
		{ *(.ram.code ) }
	__ram_code_end =  LOADADDR (.ram.code) + SIZEOF (.ram.code);
	. = . + 0;
	__rand_code_start =  LOADADDR (.rand.code);
	.rand.code 	: AT(ALIGN(LOADADDR (.ram.code) + SIZEOF (.ram.code), ALIGNOF(.rand.code)))
		{ *(.rand.code ) }
	__rand_code_end =  LOADADDR (.rand.code) + SIZEOF (.rand.code);
	. = . + 0;
	__ctxt_code_start =  LOADADDR (.ctxt.code);
	.ctxt.code 	: AT(ALIGN(LOADADDR (.rand.code) + SIZEOF (.rand.code), ALIGNOF(.ctxt.code)))
		{ *(.ctxt.code ) }
	__ctxt_code_end =  LOADADDR (.ctxt.code) + SIZEOF (.ctxt.code);
	. = 0x20002000;
	PROVIDE (_stack = 0x20002000);
	. = ALIGN(0x20);
	__data_lmastart =  LOADADDR (.eh_frame);
	__data_start = ADDR(.eh_frame);
	.eh_frame 	: AT(ALIGN(LOADADDR (.ctxt.code) + SIZEOF (.ctxt.code), 32))
		{ KEEP(*(.eh_frame )) }
	.gcc_except_table 	: AT(ALIGN(LOADADDR (.eh_frame) + SIZEOF (.eh_frame), ALIGNOF(.gcc_except_table)))
		{ KEEP(*(.gcc_except_table )) *(.gcc_except_table.* ) }
	.tdata 	: AT(ALIGN(LOADADDR (.gcc_except_table) + SIZEOF (.gcc_except_table), ALIGNOF(.tdata)))
		{ *(.tdata .tdata.* .gnu.linkonce.td.* ) }
	. = ALIGN(4);
	PROVIDE (__preinit_array_start = .);
	.preinit_array 	: AT(ALIGN(ALIGN(LOADADDR (.tdata) + SIZEOF (.tdata), ALIGNOF(.preinit_array)), 4))
		{ KEEP(*(.preinit_array )) }
	PROVIDE (__preinit_array_end = .);
	PROVIDE (__init_array_start = .);
	.init_array 	: AT(ALIGN(LOADADDR (.preinit_array) + SIZEOF (.preinit_array), ALIGNOF(.init_array)))
		{ KEEP(*(.init_array )) }
	PROVIDE (__init_array_end = .);
	PROVIDE (__fini_array_start = .);
	.fini_array 	: AT(ALIGN(LOADADDR (.init_array) + SIZEOF (.init_array), ALIGNOF(.fini_array)))
		{ KEEP(*(.fini_array )) }
	PROVIDE (__fini_array_end = .);
	.ctors 	: AT(ALIGN(LOADADDR (.fini_array) + SIZEOF (.fini_array), ALIGNOF(.ctors)))
		{ KEEP(*crtbegin*.o(.ctors)) KEEP(*(EXCLUDE_FILE (*crtend*.o) .ctors)) KEEP(*(SORT(.ctors.* ))) KEEP(*(.ctors )) }
	.dtors 	: AT(ALIGN(LOADADDR (.ctors) + SIZEOF (.ctors), ALIGNOF(.dtors)))
		{ KEEP(*crtbegin*.o(.dtors)) KEEP(*(EXCLUDE_FILE (*crtend*.o) .dtors)) KEEP(*(SORT(.dtors.* ))) KEEP(*(.dtors )) }
	.jcr 	: AT(ALIGN(LOADADDR (.dtors) + SIZEOF (.dtors), ALIGNOF(.jcr)))
		{ KEEP(*(.jcr )) }
	.data.rel.ro 	: AT(ALIGN(LOADADDR (.jcr) + SIZEOF (.jcr), ALIGNOF(.data.rel.ro)))
		{ *(.data.rel.ro.local ) *(.data.rel.ro* ) }
	.dynamic 	: AT(ALIGN(LOADADDR (.data.rel.ro) + SIZEOF (.data.rel.ro), ALIGNOF(.dynamic)))
		{ *(.dynamic ) }
	.data 	: AT(ALIGN(LOADADDR (.dynamic) + SIZEOF (.dynamic), ALIGNOF(.data)))
		{ *(.data .data.* .gnu.linkonce.d.* ) KEEP(*(.gnu.linkonce.d.*personality* )) SORT(CONSTRUCTORS) . = ALIGN(8); }
	.data1 	: AT(ALIGN(LOADADDR (.data) + SIZEOF (.data), ALIGNOF(.data1)))
		{ *(.data1 ) . = ALIGN(8); }
	. = ALIGN(4);
	.got 	: AT(ALIGN(ALIGN(LOADADDR (.data1) + SIZEOF (.data1), ALIGNOF(.got)), 4))
		{ *(.got.plt ) *(.got ) }
	.sdata_d 	: AT(ALIGN(LOADADDR (.got) + SIZEOF (.got), ALIGNOF(.sdata_d)))
		{ *(.sdata_d .sdata_d.* ) }
	.sdata_w 	: AT(ALIGN(LOADADDR (.sdata_d) + SIZEOF (.sdata_d), ALIGNOF(.sdata_w)))
		{ *(.sdata_w .sdata_w.* ) }
	.sdata_h 	: AT(ALIGN(LOADADDR (.sdata_w) + SIZEOF (.sdata_w), ALIGNOF(.sdata_h)))
		{ *(.sdata_h .sdata_h.* ) }
	.sdata_b 	: AT(ALIGN(LOADADDR (.sdata_h) + SIZEOF (.sdata_h), ALIGNOF(.sdata_b)))
		{ *(.sdata_b .sdata_b.* ) }
	.sdata_f 	: AT(ALIGN(LOADADDR (.sdata_b) + SIZEOF (.sdata_b), ALIGNOF(.sdata_f)))
		{ *(.sdata_f .sdata_f.* ) }
	. = ALIGN(4);
	_edata = .;
	PROVIDE (edata = .);
	__bss_start = .;
	PROVIDE (__sbss_start = .);
	PROVIDE (___sbss_start = .);
	.tbss 	: AT(ALIGN(ALIGN(LOADADDR (.sdata_f) + SIZEOF (.sdata_f), ALIGNOF(.tbss)), 4))
		{ *(.tbss .tbss.* .gnu.linkonce.tb.* ) *(.tcommon ) }
	.sbss_f 	: AT(ALIGN(LOADADDR (.tbss) + SIZEOF (.tbss), ALIGNOF(.sbss_f)))
		{ *(.sbss_f .sbss_f.* ) *(.scommon_f .scommon_f.* ) }
	.sbss_b 	: AT(ALIGN(LOADADDR (.sbss_f) + SIZEOF (.sbss_f), ALIGNOF(.sbss_b)))
		{ *(.sbss_b .sbss_b.* ) *(.scommon_b .scommon_b.* ) . = ALIGN(2); }
	.sbss_h 	: AT(ALIGN(LOADADDR (.sbss_b) + SIZEOF (.sbss_b), ALIGNOF(.sbss_h)))
		{ *(.sbss_h .sbss_h.* ) *(.scommon_h .scommon_h.* ) . = ALIGN(4); }
	.sbss_w 	: AT(ALIGN(LOADADDR (.sbss_h) + SIZEOF (.sbss_h), ALIGNOF(.sbss_w)))
		{ *(.sbss_w .sbss_w.* ) *(.scommon_w .scommon_w.* ) *(.dynsbss ) *(.scommon ) . = ALIGN(8); }
	.sbss_d 	: AT(ALIGN(LOADADDR (.sbss_w) + SIZEOF (.sbss_w), ALIGNOF(.sbss_d)))
		{ *(.sbss_d .sbss_d.* ) *(.scommon_d .scommon_d.* ) }
	.bss 	: AT(ALIGN(LOADADDR (.sbss_d) + SIZEOF (.sbss_d), ALIGNOF(.bss)))
		{ *(.dynbss ) *(.bss .bss.* .gnu.linkonce.b.* ) *(COMMON ) . = ALIGN(4); }
	PROVIDE (__sbss_end = .);
	PROVIDE (___sbss_end = .);
	. = ALIGN(4);
	_end = .;
	PROVIDE (end = .);
	EILM_SIZE = LOADADDR(.tbss) + SIZEOF(.tbss) - EILM_BEGIN;
	.stab	0 : { *(.stab) }
	.stabstr	0 : { *(.stabstr) }
	.stab.excl	0 : { *(.stab.excl) }
	.stab.exclstr	0 : { *(.stab.exclstr) }
	.stab.index	0 : { *(.stab.index) }
	.stab.indexstr	0 : { *(.stab.indexstr) }
	.note.nds32	0 : { *(.note.nds32) *(.note.nds32.*) }
	.comment	0 : { *(.comment) }
	.debug	0 : { *(.debug) }
	.line	0 : { *(.line) }
	.debug_srcinfo	0 : { *(.debug_srcinfo) }
	.debug_sfnames	0 : { *(.debug_sfnames) }
	.debug_aranges	0 : { *(.debug_aranges) }
	.debug_pubnames	0 : { *(.debug_pubnames) }
	.debug_info	0 : { *(.debug_info .gnu.linkonce.wi.*) }
	.debug_abbrev	0 : { *(.debug_abbrev) }
	.debug_line	0 : { *(.debug_line) }
	.debug_frame	0 : { *(.debug_frame) }
	.debug_str	0 : { *(.debug_str) }
	.debug_loc	0 : { *(.debug_loc) }
	.debug_macinfo	0 : { *(.debug_macinfo) }
	.debug_weaknames	0 : { *(.debug_weaknames) }
	.debug_funcnames	0 : { *(.debug_funcnames) }
	.debug_typenames	0 : { *(.debug_typenames) }
	.debug_varnames	0 : { *(.debug_varnames) }
}
ASSERT((DEFINED (_RELAX_END_) ? EILM_SIZE : 0x0) <= 0x00900000, OVERFLOW);
